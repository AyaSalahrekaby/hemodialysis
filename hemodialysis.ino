#include <Servo.h>
#include <DHT.h>
#include <Wire.h>
#include <Adafruit_GFX.h>
#include <Adafruit_SSD1306.h>
Adafruit_SSD1306 display(128, 64,&Wire, -1);
// Arduino pins
#define Blood_pump 12
#define Dialysis_pump 13
#define Buzzer 11
#define IRpin 2
int ir = 1;
// Temp.sensor
#define DHTPIN 10  
DHT dht(DHTPIN, DHT11);
int temp;
// Color sensor
#define S2 3       
#define S3 4      
// Note: we put S0, S1 on 5v in bread board to get 100% output freq scaling
#define colorsensorOut 5  
int frequencyR = 0;
int frequencyG = 0;
int frequencyB = 0;
//Servo motor
Servo line_clamp;  // create servo object to control a servo
int pos = 0;    // variable to store the servo position

//'Screenshot 2023-12-15 233817', 128x64px
const unsigned char image_array [] PROGMEM = {
	0xff, 0xff, 0xff, 0xff, 0xff, 0xff, 0xff, 0xff, 0xff, 0xff, 0xff, 0xff, 0xff, 0xff, 0xff, 0xff, 
	0xff, 0xff, 0xff, 0xff, 0xff, 0xff, 0xff, 0xff, 0xff, 0xff, 0xff, 0xff, 0xff, 0xff, 0xff, 0xff, 
	0xff, 0xff, 0xff, 0xff, 0xff, 0xff, 0xff, 0xff, 0xff, 0xff, 0xff, 0xff, 0xff, 0xff, 0xff, 0xff, 
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	0xff, 0xff, 0xff, 0xff, 0xff, 0xff, 0xff, 0xe7, 0xe7, 0xff, 0xff, 0xff, 0xff, 0xff, 0xff, 0xff
};

void setup() {
  Serial.begin(9600);
  dht.begin();
  display.begin(SSD1306_SWITCHCAPVCC, 0x3c); //or 0x3d
  display.clearDisplay();
  display.drawBitmap(0,0,image_array,128,64,1);
  display.display();
  display.setTextSize(2);
  display.setTextColor(WHITE);
  display.setCursor(0, 0);
  
  line_clamp.attach(9);  // attaches the servo on pin 9 to the servo object
  line_clamp.write(0);   // servo motor at angle zero
  pinMode(Blood_pump, OUTPUT);
  pinMode(Dialysis_pump, OUTPUT);
  pinMode(IRpin,INPUT);
  pinMode(Buzzer, OUTPUT);
  //Color
  pinMode(S2, OUTPUT);
  pinMode(S3, OUTPUT);
  pinMode(colorsensorOut, INPUT);
}

void loop() {
  digitalWrite(Blood_pump, HIGH);     
  digitalWrite(Dialysis_pump, HIGH);
  // first we read the blood temperature 
  // And if it is different, we stop the flow and close the line
  temp = dht.readTemperature();
  // Serial.print("Temperature: ");
  // Serial.print(temp);
  // Serial.println(" C");
  if (temp == 10)
  {
   for (pos = 0; pos <= 90; pos += 1) { // goes from 0 degrees to 180 degrees
    // in steps of 1 degree
    line_clamp.write(pos);              // tell servo to go to position in variable 'pos'
    delay(15);                       // waits 15ms for the servo to reach the position
   }
   digitalWrite(Blood_pump, LOW);
   tone(Buzzer, 1000); // Send 1KHz sound signal...
   display.clearDisplay();
   display.setCursor(0, 0);  
   display.println("Change in");
   display.print("Temperature");
   display.display();
  }
  // first we see if there is red color
  // And thats mean the line contain blood
  digitalWrite(S2,LOW);
  digitalWrite(S3,LOW);
  frequencyR = pulseIn(colorsensorOut, LOW);
  // Serial.print("R= ");
  // Serial.print(frequencyR);
  // Serial.print("  ");
  delay(100);

  digitalWrite(S2,LOW);
  digitalWrite(S3,HIGH);
  frequencyB = pulseIn(colorsensorOut, LOW);
  // Serial.print("B= ");
  // Serial.print(frequencyB);
  // Serial.print("  ");
  delay(100);

   
  digitalWrite(S2,HIGH);
  digitalWrite(S3,HIGH);
  frequencyG = pulseIn(colorsensorOut, LOW);
  // Serial.print("G= ");
  // Serial.print(frequencyG);
  // Serial.println("  ");
  delay(100);
  if (frequencyR<frequencyB && frequencyR<=frequencyG && frequencyR<15) //if Red value is the lowest one and smaller thant 23 it's likely Red
  { //Serial.println("Blood leakage");
    tone(Buzzer, 1000); // Send 1KHz sound signal...
    display.clearDisplay();  
    display.setCursor(0, 0);
    display.println("Blood");
    display.print("Leakage");
    display.display();
  }
  ir= digitalRead(IRpin);
  Serial.println(ir);
  if ( ir == 0)
  {
   for (pos = 90; pos <= 270; pos += 1) { // goes from 0 degrees to 180 degrees
    // in steps of 1 degree
    line_clamp.write(pos);              // tell servo to go to position in variable 'pos'
    delay(15);                       // waits 15ms for the servo to reach the position
   }
   digitalWrite(Blood_pump, LOW);
   tone(Buzzer, 1000); // Send 1KHz sound signal...
   display.clearDisplay();
   display.setCursor(0, 0);
   display.println("Air ");
   display.print("bubble");
   display.display();
  }
}